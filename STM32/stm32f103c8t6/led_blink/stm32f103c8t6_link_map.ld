MEMORY
{
	/* Флэш память с возможностью чтения (R) и выполнения (X) кода
	Адрес начала флеш памяти 0x08000000
	Размер флэш памяти 128kb (0x20000) */
	FLASH (RX) : ORIGIN = 0x08000000, LENGTH = 0x20000
}

SECTIONS
{
	/* Собираем секции .text из всех входных файлов ( *(.text) ) 
	и направляем их в секцию .text выходного файла, 
	которую в свою очередь записываем во флэш память */ 
	.text :
	{
		*(.text);	 
	} > FLASH		
}